## components/OpenLTTO_Hardware/Kconfig.projbuild
```kconfig
menu "OpenLTTO Hardware Config"
    menu "I2C Bus"

        config OPENLTTO_HW_I2C_NUM
            int "I2C peripheral index"
            default 1
            range 0 1
            help
                ESP32S3 has two I2C peripherals, pick the one you want to use.

         config OPENLTTO_HW_I2C_SDA_IO
            int "I2C GPIO Pin for SDA"
            default 12
            range 0 100
            help
                GPIO Pin for I2C SDA Signalling

        config OPENLTTO_HW_I2C_SCL_IO
            int "I2C GPIO Pin for SCL"
            default 11
            range 0 100
            help
                GPIO Pin for I2C SCL Signalling

        config OPENLTTO_HW_I2C_FAST_MODE
            bool "Enable I2C fast mode"
            default y
            help
                I2C has two speed modes: normal (100kHz) and fast (400kHz).

        config OPENLTTO_HW_I2C_CLK_SPEED_HZ
            int
            default 400000 if OPENLTTO_HW_I2C_FAST_MODE
            default 100000

    endmenu
endmenu
```

## components/OpenLTTO_UI/Kconfig.projbuild
```kconfig
menu "OpenLTTO UI Configuration"

    config OPENLTTO_UI_EVENT_TASK_HEAP
        int "OpenLTTO OpenLTTO UI Task Heap Memory Allocation (kb)"
        default 4
        range 0 128
        help
            KB of Heap RAM to allocate for the Task

    config OPENLTTO_UI_EVENT_TASK_PRIORITY
        int "OpenLTTO OpenLTTO UI Task Priority"
        default 3
        range 0 16
        help
            Task Priority for the Task

     config OPENLTTO_UI_EVENT_QUEUE_DEPTH
        int "OpenLTTO OpenLTTO UI Event Queue Depth"
        default 5
        range 0 256
        help
            Queue Depth for the Event Loop

     config OPENLTTO_UI_EVENT_EMITTER_BLOCK_DURATION
        int "OpenLTTO OpenLTTO UI Event Emitter Blocking time in ms"
        default 100
        range 0 1000
        help
            ms to block event emitter on full event queue

    config OPENLTTO_UI_DISPLAY_BRIGHTNESS_LEDC_CH
        int "LEDC channel index"
        default 1
        range 0 7
        help
            LEDC channel is used to generate PWM signal that controls display brightness.
            Set LEDC index that should be used.

endmenu
```

## sdkconfig.defaults
```kconfig
#
# General FreeRTOS configuration
#
CONFIG_FREERTOS_HZ=1000

#
# LVGL configuration
#
CONFIG_LV_COLOR_DEPTH_16=y
CONFIG_LV_COLOR_DEPTH=16
CONFIG_LV_COLOR_16_SWAP=y
CONFIG_LV_FONT_MONTSERRAT_24=y
CONFIG_LV_MEM_SIZE_KILOBYTES=16
```
